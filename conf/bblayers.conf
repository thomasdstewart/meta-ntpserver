## conf/bblayers.conf
```bitbake
# POKY_BBLAYERS_CONF_VERSION is increased each time build/conf/bblayers.conf
# changes incompatibly
POKY_BBLAYERS_CONF_VERSION = "2"

BBPATH = "${TOPDIR}"
BBFILES ?= ""

YOCTOROOT = "${@os.path.abspath(os.path.join("${TOPDIR}", os.pardir))}"

BBLAYERS ?= " \
  ${YOCTOROOT}/meta-ntpserver/poky/meta \
  ${YOCTOROOT}/meta-ntpserver/poky/meta-poky \
  ${YOCTOROOT}/meta-ntpserver/poky/meta-yocto-bsp \
  ${YOCTOROOT}/meta-ntpserver/meta-openembedded/meta-oe \
  ${YOCTOROOT}/meta-ntpserver/meta-openembedded/meta-python \
  ${YOCTOROOT}/meta-ntpserver/meta-openembedded/meta-networking \
  ${YOCTOROOT}/meta-ntpserver/meta-ntpserver \
  "
```

## conf/distro/ntpserver.conf
```bitbake
include conf/distro/poky.conf

DISTRO = "ntpserver"
DISTRO_NAME = "ntpserver"

INIT_MANAGER = "systemd"

DISTRO_FEATURES = "argp ext2 ipv4 ipv6 pci"
```

## conf/layer.conf
```bitbake
# We have a conf and classes directory, add to BBPATH
BBPATH .= ":${LAYERDIR}"

# We have recipes-* directories, add to BBFILES
BBFILES += "${LAYERDIR}/recipes-*/*/*.bb \
            ${LAYERDIR}/recipes-*/*/*.bbappend"

BBFILE_COLLECTIONS += "meta-ntpserver"
BBFILE_PATTERN_meta-ntpserver = "^${LAYERDIR}/"
BBFILE_PRIORITY_meta-ntpserver = "6"

LAYERDEPENDS_ntpserver = "core"
LAYERSERIES_COMPAT_meta-ntpserver = "hardknott"
```

## conf/machine/galleon.conf
```bitbake
#@TYPE: Machine
#@NAME: gallean
#@DESCRIPTION: gallean ntp server
#
#meta-yocto-bsp/conf/machine/genericx86.conf
#meta-yocto-bsp/conf/machine/include/genericx86-common.inc
#meta/conf/machine/include/x86-base.inc
#meta/conf/machine/include/qemuboot-x86.inc

DEFAULTTUNE = "c3"
require conf/machine/include/tune-c3.inc

MACHINE_FEATURES += "acpi ext2 pcbios pci screen serial x86"
IMAGE_FSTYPES += "wic"
WKS_FILE_galleon = "galleon.wks"
WKS_FILE_DEPENDS_BOOTLOADERS_galleon = "syslinux"

PREFERRED_VERSION_linux-yocto ?= "5.10%"
PREFERRED_PROVIDER_virtual/kernel ?= "linux-yocto"

EXTRA_IMAGEDEPENDS += "qemu-native qemu-helper-native"
IMAGE_CLASSES += "qemuboot"

QB_SYSTEM_NAME = "qemu-system-i386"
QB_SYSTEM_NAME_x86 = "qemu-system-i386"
QB_CPU_x86 = "-cpu pentium2"
QB_CPU_KVM_x86 = "-cpu pentium2"
QB_KERNEL_CMDLINE_APPEND = "vga=0"

KERNEL_IMAGETYPE = "bzImage"
SERIAL_CONSOLES = "9600;ttyS0"

MACHINE_ESSENTIAL_EXTRA_RRECOMMENDS += "kernel-modules"
```

## wic/galleon.wks
```
part /boot --source bootimg-pcbios --ondisk sda --fstype=vfat --label boot --active --align 1024 --size 64 --fsoptions="ro,defaults"
part / --source rootfs --ondisk sda --fstype=ext4 --label rootfsA --align 1024 --fixed-size 200M
part / --source rootfs --ondisk sda --fstype=ext4 --label rootfsB --align 1024 --fixed-size 200M
part /root --ondisk sda --fstype=ext4 --label srv --align 1024 --fixed-size 400M

bootloader --configfile="syslinux-custom.cfg"
```
